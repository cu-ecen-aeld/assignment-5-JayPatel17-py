## base_external/Config.in
```kconfig
source "$BR2_EXTERNAL_project_base_PATH/package/aesd-assignments/Config.in"
source "$BR2_EXTERNAL_project_base_PATH/package/misc-modules/Config.in"
source "$BR2_EXTERNAL_project_base_PATH/package/scull/Config.in"
```

## base_external/package/misc-modules/Config.in
```kconfig
config BR2_PACKAGE_MISC_MODULES
	bool "MISC_MODULES"
	help
	  My misc modules prints hello world and github username
```
